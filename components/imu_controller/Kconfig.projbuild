## components/imu_controller/Kconfig.projbuild
```kconfig
menu "IMU Controller"

    config IMU_CONTROLLER_MAX_SUPPORTED_UNITS
        int "Max IMUs"
        default 1
        help
            The maximum number of IMUs supported

    config IMU_CONTROLLER_SPI_BUS_FREQ
        int "SPI bus frequency"
        default 10000000
        help
            The SPI bus speed for every IMU in Hz

    config IMU_BUFFER_NUM_FRAMES
        int "Number of buffer frames"
        default 20
        help
            Number of accel/gyro data frames to buffer

endmenu
```
